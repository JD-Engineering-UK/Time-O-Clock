## main/Kconfig.projbuild
```kconfig
menu "Time O'Clock Configuration"
    config SNTP_TIME_SERVER
            string "SNTP server name"
            default "pool.ntp.org"
            help
                Hostname of the main SNTP server.

    config TIME_OCLOCK_WEBHOOK
        string "Time o'Clock Webhook"
    config FRIDAY_NIGHT_WEBHOOK
            string "Friday Night Webhook"

endmenu
```

## sdkconfig.defaults.esp32
```kconfig
CONFIG_ESPTOOLPY_FLASHSIZE_4MB=y
CONFIG_ESP_DEFAULT_CPU_FREQ_MHZ_240=y
CONFIG_ESP_DEFAULT_CPU_FREQ_MHZ=240
```
